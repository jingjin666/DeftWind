## modules/Framework/nuttx-configs/uavrs-v2/nsh/defconfig
```kconfig
CONFIG_ARCH="arm"
CONFIG_ARCH_BOARD_CUSTOM=y
CONFIG_ARCH_BOARD_CUSTOM_NAME="dp"
CONFIG_ARCH_BOARD_CUSTOM_DIR="configs/uavrs-v2"
CONFIG_ARCH_CHIP_IMXRT=y
CONFIG_ARCH_CHIP_MIMXRT1052DVL6A=y
CONFIG_ARCH_STACKDUMP=y
CONFIG_ARMV7M_DCACHE=y
CONFIG_ARMV7M_DCACHE_WRITETHROUGH=y
CONFIG_ARMV7M_ICACHE=y
CONFIG_ARMV7M_USEBASEPRI=y
CONFIG_BOARD_LOOPSPERMSEC=104926
CONFIG_BUILTIN=y
CONFIG_FS_PROCFS=y
CONFIG_IDLETHREAD_STACKSIZE=2048
CONFIG_INTELHEX_BINARY=y
CONFIG_MAX_TASKS=16
CONFIG_MAX_WDOGPARMS=2
CONFIG_NFILE_DESCRIPTORS=8
CONFIG_NFILE_STREAMS=8
CONFIG_NSH_ARCHINIT=y
CONFIG_NSH_BUILTIN_APPS=y
CONFIG_NSH_DISABLE_IFUPDOWN=y
CONFIG_NSH_FILEIOSIZE=512
CONFIG_NSH_LINELEN=64
CONFIG_NSH_READLINE=y
CONFIG_PREALLOC_MQ_MSGS=4
CONFIG_PREALLOC_WDOGS=16
CONFIG_RAM_SIZE=524288
CONFIG_RAM_START=0x20200000
CONFIG_START_DAY=14
CONFIG_START_MONTH=3
CONFIG_USER_ENTRYPOINT="nsh_main"

CONFIG_FS_ROMFS=y
CONFIG_NSH_ROMFSETC=y
CONFIG_NSH_ARCHROMFS=y

#
# Board-Specific Options
#
CONFIG_LIB_BOARDCTL=y
CONFIG_BOARDCTL_USBDEVCTRL=y

#
# System Libraries and NSH Add-Ons
#
CONFIG_SYSTEM_CDCACM=y
CONFIG_SYSTEM_CDCACM_DEVMINOR=0
CONFIG_SYSTEM_NSH=y
CONFIG_SYSTEM_NSH_PRIORITY=100
CONFIG_SYSTEM_NSH_STACKSIZE=2048
CONFIG_READLINE_HAVE_EXTMATCH=y
CONFIG_SYSTEM_READLINE=y
CONFIG_READLINE_ECHO=y

#
# USB Device Controller Driver Options
#
#CONFIG_USBDEV=y
CONFIG_USBDEV_BUSPOWERED=y
CONFIG_USBDEV_MAXPOWER=500

#
# USB Device Class Driver Options
#
CONFIG_CDCACM=y
CONFIG_CDCACM_EP0MAXPACKET=64
CONFIG_CDCACM_EPINTIN=1
CONFIG_CDCACM_EPINTIN_FSSIZE=64
CONFIG_CDCACM_EPINTIN_HSSIZE=64
CONFIG_CDCACM_EPBULKOUT=3
CONFIG_CDCACM_EPBULKOUT_FSSIZE=64
CONFIG_CDCACM_EPBULKOUT_HSSIZE=512
CONFIG_CDCACM_EPBULKIN=2
CONFIG_CDCACM_EPBULKIN_FSSIZE=64
CONFIG_CDCACM_EPBULKIN_HSSIZE=512
CONFIG_CDCACM_NRDREQS=4
CONFIG_CDCACM_NWRREQS=4
CONFIG_CDCACM_BULKIN_REQLEN=96
CONFIG_CDCACM_RXBUFSIZE=600
CONFIG_CDCACM_TXBUFSIZE=2000
CONFIG_CDCACM_VENDORID=0x26ac
CONFIG_CDCACM_PRODUCTID=0x0011
CONFIG_CDCACM_VENDORSTR="UAVRS"
CONFIG_CDCACM_PRODUCTSTR="UAVRS FMU v2.x"

#
# Basic CXX Support
#
CONFIG_C99_BOOL8=y
CONFIG_HAVE_CXX=y
# CONFIG_CXX_NEWLONG is not set

#
# LLVM C++ Library (libcxx)
#
# CONFIG_LIBCXX is not set

#
# uClibc++ Standard C++ Library
#
# CONFIG_UCLIBCXX is not set
# CONFIG_LIBDSP is not set

#
# Platform-specific Support
#
# CONFIG_PLATFORM_CONFIGDATA is not set
CONFIG_HAVE_CXXINITIALIZE=y


CONFIG_IMXRT_LPUART1=y
CONFIG_IMXRT_LPUART5=y
CONFIG_LPUART1_SERIAL_CONSOLE=y
CONFIG_SERIAL_CONSOLE=y

#
# eDMA Configuration
#
CONFIG_IMXRT_USDHC=y
CONFIG_IMXRT_USDHC_DMA=y

#
# eDMA Configuration
#
CONFIG_IMXRT_EDMA_NTCD=0
# CONFIG_IMXRT_EDMA_ELINK is not set
# CONFIG_IMXRT_EDMA_ERCA is not set
CONFIG_IMXRT_EDMA_HOE=y
# CONFIG_IMXRT_EDMA_CLM is not set
# CONFIG_IMXRT_EDMA_EMLIM is not set
# CONFIG_IMXRT_EDMA_EDBG is not set

CONFIG_ARCH_HAVE_SDIO=y
# CONFIG_ARCH_HAVE_SDIOWAIT_WRCOMPLETE is not set
# CONFIG_ARCH_HAVE_SDIO_PREFLIGHT is not set
# CONFIG_ARCH_HAVE_SDIO_DELAYED_INVLDT is not set
CONFIG_MMCSD=y
CONFIG_MMCSD_NSLOTS=1
# CONFIG_MMCSD_READONLY is not set
# CONFIG_MMCSD_MULTIBLOCK_DISABLE is not set
CONFIG_MMCSD_MMCSUPPORT=y
# CONFIG_MMCSD_HAVE_CARDDETECT is not set
# CONFIG_MMCSD_HAVE_WRITEPROTECT is not set
# CONFIG_MMCSD_SPI is not set
CONFIG_SDIO_DMA=y
CONFIG_MMCSD_SDIO=y
# CONFIG_SDIO_MUXBUS is not set
# CONFIG_SDIO_WIDTH_D1_ONLY is not set
CONFIG_SDIO_BLOCKSETUP=y

#
# Work queue support
#
CONFIG_SCHED_WORKQUEUE=y
# CONFIG_WQUEUE_NOTIFIER is not set
CONFIG_SCHED_HPWORK=y
#CONFIG_SCHED_HPNTHREADS=1
#CONFIG_SCHED_HPWORKPRIORITY=249
#CONFIG_SCHED_HPWORKSTACKSIZE=1800
#CONFIG_SCHED_LPWORK=y
#CONFIG_SCHED_LPNTHREADS=1
#CONFIG_SCHED_LPWORKPRIORITY=50
#CONFIG_SCHED_LPWORKPRIOMAX=176
#CONFIG_SCHED_LPWORKSTACKSIZE=1800

# File system configuration
#
# CONFIG_DISABLE_MOUNTPOINT is not set
# CONFIG_FS_AUTOMOUNTER is not set
# CONFIG_DISABLE_PSEUDOFS_OPERATIONS is not set
# CONFIG_PSEUDOFS_SOFTLINKS is not set
CONFIG_FS_READABLE=y
CONFIG_FS_WRITABLE=y
# CONFIG_FS_AIO is not set
# CONFIG_FS_NAMED_SEMAPHORES is not set
CONFIG_FS_MQUEUE_MPATH="/var/mqueue"
# CONFIG_FS_RAMMAP is not set

#
# Partition Table
#
# CONFIG_PTABLE_PARTITION is not set
CONFIG_FS_FAT=y
CONFIG_FAT_LCNAMES=y
CONFIG_FAT_LFN=y
CONFIG_FAT_MAXFNAME=32
CONFIG_FAT_LFN_ALIAS_HASH=y
CONFIG_FAT_LFN_ALIAS_TRAILCHARS=0
CONFIG_FS_FATTIME=y
# CONFIG_FAT_FORCE_INDIRECT is not set
CONFIG_FAT_DMAMEMORY=y
CONFIG_FAT_DIRECT_RETRY=y
# CONFIG_FS_NXFFS is not set
CONFIG_FS_ROMFS=y
# CONFIG_FS_CROMFS=y
# CONFIG_FS_TMPFS is not set
# CONFIG_FS_SMARTFS is not set
CONFIG_FS_BINFS=y
CONFIG_FS_PROCFS=y
CONFIG_FS_PROCFS_REGISTER=y

#
# Exclude individual procfs entries
#
# CONFIG_FS_PROCFS_EXCLUDE_PROCESS is not set
CONFIG_FS_PROCFS_EXCLUDE_ENVIRON=y
CONFIG_FS_PROCFS_EXCLUDE_BLOCKS=y
CONFIG_FS_PROCFS_EXCLUDE_MOUNT=y
CONFIG_FS_PROCFS_EXCLUDE_USAGE=y
# CONFIG_FS_PROCFS_EXCLUDE_UPTIME is not set
CONFIG_FS_PROCFS_EXCLUDE_VERSION=y
# CONFIG_FS_PROCFS_EXCLUDE_MEMINFO is not set
CONFIG_FS_PROCFS_EXCLUDE_MOUNTS=y
CONFIG_FS_PROCFS_EXCLUDE_PARTITIONS=y
# CONFIG_FS_SPIFFS is not set
# CONFIG_FS_LITTLEFS is not set
# CONFIG_FS_UNIONFS is not set
# CONFIG_FS_HOSTFS is not set

#
# Memory Management
#
# CONFIG_MM_SMALL is not set
#CONFIG_MM_REGIONS=1
# CONFIG_ARCH_HAVE_HEAP2 is not set
CONFIG_GRAN=y
CONFIG_GRAN_INTR=y
# CONFIG_MM_FILL_ALLOCATIONS is not set

#
# Debug SYSLOG Output Controls
#
#CONFIG_DEBUG_FEATURES=y
#CONFIG_DEBUG_ERROR=y
#CONFIG_DEBUG_WARN=y
#CONFIG_DEBUG_INFO=y
# CONFIG_DEBUG_ASSERTIONS is not set

#
# Subsystem Debug Options
#
#CONFIG_DEBUG_BINFMT is not set
#CONFIG_DEBUG_FS=y
#CONFIG_DEBUG_FS_ERROR=y
#CONFIG_DEBUG_FS_WARN=y
#CONFIG_DEBUG_FS_INFO=y

#CONFIG_DEBUG_MEMCARD=y
#CONFIG_DEBUG_MEMCARD_ERROR=y
#CONFIG_DEBUG_MEMCARD_WARN=y
#CONFIG_DEBUG_MEMCARD_INFO=y

#CONFIG_SDIO_XFRDEBUG=y

#
# Customize Header Files
#
CONFIG_ARCH_MATH_H=y

CONFIG_ARCH_HAVE_I2CRESET=y
CONFIG_I2C=y
CONFIG_I2C_RESET=y
CONFIG_IMXRT_LPI2C=y
CONFIG_IMXRT_LPI2C1=y

CONFIG_SPI=y
CONFIG_IMXRT_LPSPI=y
CONFIG_IMXRT_LPSPI3=y
```
