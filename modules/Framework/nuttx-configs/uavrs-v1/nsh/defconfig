## modules/Framework/nuttx-configs/uavrs-v1/nsh/defconfig
```kconfig
#******************************************CUSTOM******************************************#
CONFIG_NUTTX_NEWCONFIG=y

#
# Build Setup
#
CONFIG_HOST_LINUX=y

#
# Build Configuration
#
CONFIG_APPS_DIR="../apps"

#
# Binary Output Formats
#
CONFIG_RAW_BINARY=y

#
# Customize Header Files
#
CONFIG_ARCH_MATH_H=y

#
# Debug Options
#
CONFIG_DEBUG=n
CONFIG_DEBUG_VERBOSE=n

#
# Subsystem Debug Options
#

#
# Driver Debug Options
#
CONFIG_DEBUG_DMA=y
CONFIG_DEBUG_SYMBOLS=y

#
# System Type
#
CONFIG_ARCH_ARM=y
CONFIG_ARCH="arm"

#
# ARM Options
#
CONFIG_ARCH_CHIP_STM32=y
CONFIG_ARCH_CORTEXM4=y
CONFIG_ARCH_FAMILY="armv7-m"
CONFIG_ARCH_CHIP="stm32"
CONFIG_ARMV7M_USEBASEPRI=y
CONFIG_ARCH_HAVE_CMNVECTOR=y
CONFIG_ARMV7M_CMNVECTOR=y
CONFIG_ARCH_HAVE_FPU=y
CONFIG_ARCH_FPU=y
CONFIG_ARCH_HAVE_MPU=y

#
# ARMV7M Configuration Options
#
CONFIG_ARMV7M_TOOLCHAIN_GNU_EABI=y
CONFIG_ARMV7M_STACKCHECK=n
CONFIG_SERIAL_TERMIOS=y
CONFIG_SDIO_DMA=y
CONFIG_SDIO_DMAPRIO=0x00010000

#
# STM32 Configuration Options
#
CONFIG_ARCH_CHIP_STM32F427V=y
CONFIG_STM32_STM32F4XXX=y
CONFIG_STM32_STM32F427=y

#
# STM32 Peripheral Support
#
CONFIG_STM32_ADC1=y
CONFIG_STM32_BKPSRAM=y
CONFIG_STM32_CCMDATARAM=y
CONFIG_STM32_DMA1=y
CONFIG_STM32_DMA2=y
CONFIG_STM32_DMA1=y
CONFIG_STM32_DMA2=y
CONFIG_STM32_I2C1=y
CONFIG_STM32_I2C2=y
CONFIG_STM32_OTGFS=y
CONFIG_STM32_PWR=y
CONFIG_STM32_SDIO=y
CONFIG_STM32_SPI2=y
CONFIG_STM32_SPI3=y
CONFIG_STM32_SPI4=y
CONFIG_STM32_SYSCFG=y
CONFIG_STM32_TIM1=y
CONFIG_STM32_TIM3=y
CONFIG_STM32_TIM4=y

CONFIG_STM32_TIM10=y
CONFIG_STM32_TIM11=y
CONFIG_STM32_USART1=y
CONFIG_STM32_USART2=y
CONFIG_STM32_USART3=y
CONFIG_STM32_UART4=y
CONFIG_STM32_USART6=y
CONFIG_STM32_UART7=y
CONFIG_STM32_UART8=y
CONFIG_STM32_WWDG=y
CONFIG_STM32_ADC=y
CONFIG_STM32_SPI=y
CONFIG_STM32_I2C=y

#
# Alternate Pin Mapping
#
CONFIG_STM32_FLASH_PREFETCH=y
CONFIG_STM32_JTAG_SW_ENABLE=y
CONFIG_STM32_DISABLE_IDLE_SLEEP_DURING_DEBUG=y
CONFIG_STM32_DMACAPABLE=y
CONFIG_STM32_USART=y

#
# U[S]ART Configuration
#
# Hot fix for lost data
CONFIG_STM32_RXDMA_BUFFER_SIZE_OVERRIDE=256
CONFIG_USART2_RXDMA=y
CONFIG_USART3_RXDMA=y
CONFIG_UART4_RXDMA=y
CONFIG_UART5_RXDMA=y
CONFIG_USART6_RXDMA=y
CONFIG_UART8_RXDMA=y
CONFIG_SERIAL_DISABLE_REORDERING=y
CONFIG_STM32_USART_SINGLEWIRE=y

#
# SPI Configuration
#
CONFIG_STM32_SPI_DMA=y

#
# I2C Configuration
#
CONFIG_STM32_I2CTIMEOSEC=0
CONFIG_STM32_I2CTIMEOMS=10

#
# SDIO Configuration
#
CONFIG_SDIO_PRI=128

#
# USB Host Configuration
#

#
# USB Device Configuration
#

#
# External Memory Configuration
#

#
# Architecture Options
#
CONFIG_ARCH_DMA=y
CONFIG_ARCH_HAVE_VFORK=y
CONFIG_ARCH_STACKDUMP=y
CONFIG_ARCH_HAVE_RAMVECTORS=y

#
# Board Settings
#
CONFIG_BOARD_LOOPSPERMSEC=16717
CONFIG_DRAM_START=0x20000000
CONFIG_DRAM_SIZE=262144
CONFIG_ARCH_HAVE_INTERRUPTSTACK=y
# The actual usage is 420 bytes
CONFIG_ARCH_INTERRUPTSTACK=750

#
# Boot options
#
CONFIG_BOOT_RUNFROMFLASH=y

#
# Board Selection
#
CONFIG_ARCH_BOARD_CUSTOM=y
CONFIG_ARCH_BOARD_CUSTOM_NAME="uavrs-v1"
CONFIG_ARCH_BOARD_CUSTOM_DIR="configs/uavrs-v1"
#CONFIG_BOARD_CUSTOM_LEDS=y
CONFIG_ARCH_BOARD="uavrs-v1"

#
# Common Board Options
#
CONFIG_NSH_MMCSDMINOR=0
CONFIG_NSH_MMCSDSLOTNO=0
CONFIG_MMCSD_HAVE_SDIOWAIT_WRCOMPLETE=y

#
# Board-Specific Options
#

#
# RTOS Features
#
CONFIG_MSEC_PER_TICK=1
CONFIG_RR_INTERVAL=0
CONFIG_SCHED_INSTRUMENTATION=y
CONFIG_SCHED_INSTRUMENTATION_BUFFER=y
CONFIG_TASK_NAME_SIZE=24
CONFIG_START_YEAR=1970
CONFIG_START_MONTH=1
CONFIG_START_DAY=1
CONFIG_DEV_CONSOLE=y
CONFIG_PRIORITY_INHERITANCE=y
CONFIG_SEM_PREALLOCHOLDERS=0
CONFIG_SEM_NNESTPRIO=8
CONFIG_FDCLONE_STDIO=y
CONFIG_SDCLONE_DISABLE=y
CONFIG_SCHED_WAITPID=y
CONFIG_SCHED_ATEXIT=y
CONFIG_SCHED_ATEXIT_MAX=1
CONFIG_USER_ENTRYPOINT="nsh_main"


#
# Signal Numbers
#
CONFIG_SIG_SIGUSR1=1
CONFIG_SIG_SIGUSR2=2
CONFIG_SIG_SIGALARM=3
CONFIG_SIG_SIGCONDTIMEDOUT=16
CONFIG_SIG_SIGWORK=4

#
# Sizes of configurable things (0 disables)
#
CONFIG_MAX_TASKS=32
CONFIG_MAX_TASK_ARGS=10
CONFIG_NPTHREAD_KEYS=4
CONFIG_NFILE_DESCRIPTORS=50
CONFIG_NFILE_STREAMS=8
CONFIG_NAME_MAX=32
CONFIG_PREALLOC_MQ_MSGS=4
CONFIG_MQ_MAXMSGSIZE=32
CONFIG_MAX_WDOGPARMS=2
CONFIG_PREALLOC_WDOGS=50
CONFIG_PREALLOC_TIMERS=50

#
# Stack and heap information
#
CONFIG_IDLETHREAD_STACKSIZE=1000
CONFIG_USERMAIN_STACKSIZE=2500
CONFIG_PTHREAD_STACK_MIN=512
CONFIG_PTHREAD_STACK_DEFAULT=2048

#
# Device Drivers
#
CONFIG_DEV_NULL=y
CONFIG_I2C=y
CONFIG_I2C_TRANSFER=y
CONFIG_ARCH_HAVE_I2CRESET=y
CONFIG_I2C_RESET=y
CONFIG_SPI=y
CONFIG_SPI_CALLBACK=n
CONFIG_SPI_EXCHANGE=y
CONFIG_STM32_RTC=y
CONFIG_RTC=y
CONFIG_RTC_DATETIME=y
CONFIG_RTC_HSECLOCK=y
CONFIG_WATCHDOG=y
CONFIG_MMCSD=y
CONFIG_MMCSD_NSLOTS=1
CONFIG_MMCSD_MULTIBLOCK_DISABLE=y
CONFIG_MMCSD_SDIO=y
CONFIG_MTD=y

#
# MTD Configuration
#
CONFIG_MTD_PARTITION=y
CONFIG_MTD_BYTE_WRITE=y

#
# MTD Device Drivers
#
CONFIG_MTD_RAMTRON=y
CONFIG_PIPES=y
CONFIG_SERIAL=y
CONFIG_SERIAL_REMOVABLE=y
CONFIG_ARCH_HAVE_UART4=y
CONFIG_ARCH_HAVE_UART7=y
CONFIG_ARCH_HAVE_UART8=y
CONFIG_ARCH_HAVE_USART1=y
CONFIG_ARCH_HAVE_USART2=y
CONFIG_ARCH_HAVE_USART3=y
CONFIG_ARCH_HAVE_USART6=y
CONFIG_MCU_SERIAL=y
CONFIG_STANDARD_SERIAL=y
CONFIG_SERIAL_NPOLLWAITERS=2
CONFIG_UART7_SERIAL_CONSOLE=y

#
# USART1 Configuration
#
CONFIG_USART1_RXBUFSIZE=128
CONFIG_USART1_TXBUFSIZE=32
CONFIG_USART1_BAUD=115200
CONFIG_USART1_BITS=8
CONFIG_USART1_PARITY=0
CONFIG_USART1_2STOP=0

#
# USART2 Configuration
#
CONFIG_USART2_RXBUFSIZE=600
CONFIG_USART2_TXBUFSIZE=1100
CONFIG_USART2_BAUD=57600
CONFIG_USART2_BITS=8
CONFIG_USART2_PARITY=0
CONFIG_USART2_2STOP=0


#
# USART3 Configuration
#
CONFIG_USART3_RXBUFSIZE=300
CONFIG_USART3_TXBUFSIZE=300
CONFIG_USART3_BAUD=57600
CONFIG_USART3_BITS=8
CONFIG_USART3_PARITY=0
CONFIG_USART3_2STOP=0


#
# UART4 Configuration
#
CONFIG_UART4_RXBUFSIZE=300
CONFIG_UART4_TXBUFSIZE=300
CONFIG_UART4_BAUD=57600
CONFIG_UART4_BITS=8
CONFIG_UART4_PARITY=0
CONFIG_UART4_2STOP=0

#
# USART6 Configuration
#
CONFIG_USART6_RXBUFSIZE=300
CONFIG_USART6_TXBUFSIZE=300
CONFIG_USART6_BAUD=57600
CONFIG_USART6_BITS=8
CONFIG_USART6_PARITY=0
CONFIG_USART6_2STOP=0

#
# UART7 Configuration
#
CONFIG_UART7_RXBUFSIZE=300
CONFIG_UART7_TXBUFSIZE=300
CONFIG_UART7_BAUD=57600
CONFIG_UART7_BITS=8
CONFIG_UART7_PARITY=0
CONFIG_UART7_2STOP=0

#
# UART8 Configuration
#
CONFIG_UART8_RXBUFSIZE=300
CONFIG_UART8_TXBUFSIZE=300
CONFIG_UART8_BAUD=57600
CONFIG_UART8_BITS=8
CONFIG_UART8_PARITY=0
CONFIG_UART8_2STOP=0
CONFIG_SERIAL_IFLOWCONTROL=y
CONFIG_SERIAL_OFLOWCONTROL=y
CONFIG_USBDEV=y

#
# USB Device Controller Driver Options
#
CONFIG_USBDEV_BUSPOWERED=y
CONFIG_USBDEV_MAXPOWER=500

#
# USB Device Class Driver Options
#
CONFIG_CDCACM=y
CONFIG_CDCACM_EP0MAXPACKET=64
CONFIG_CDCACM_EPINTIN=1
CONFIG_CDCACM_EPINTIN_FSSIZE=64
CONFIG_CDCACM_EPINTIN_HSSIZE=64
CONFIG_CDCACM_EPBULKOUT=3
CONFIG_CDCACM_EPBULKOUT_FSSIZE=64
CONFIG_CDCACM_EPBULKOUT_HSSIZE=512
CONFIG_CDCACM_EPBULKIN=2
CONFIG_CDCACM_EPBULKIN_FSSIZE=64
CONFIG_CDCACM_EPBULKIN_HSSIZE=512
CONFIG_CDCACM_NWRREQS=4
CONFIG_CDCACM_NRDREQS=4
CONFIG_CDCACM_BULKIN_REQLEN=96
CONFIG_CDCACM_RXBUFSIZE=600
CONFIG_CDCACM_TXBUFSIZE=8000
CONFIG_CDCACM_VENDORID=0x26ac
CONFIG_CDCACM_PRODUCTID=0x0011
CONFIG_CDCACM_VENDORSTR="3D Robotics"
CONFIG_CDCACM_PRODUCTSTR="PX4 FMU v2.x"

#
# System Logging Device Options
#

#
# System Logging
#

#
# Networking Support
#

#
# File Systems
#

#
# File system configuration
#
CONFIG_FS_FAT=y
CONFIG_FAT_LCNAMES=y
CONFIG_FAT_LFN=y
CONFIG_FAT_MAXFNAME=32
CONFIG_FS_FATTIME=y
CONFIG_FAT_DMAMEMORY=y
CONFIG_FS_ROMFS=y
CONFIG_FS_BINFS=y

#
# System Logging
#

#
# Graphics Support
#

#
# Memory Management
#
CONFIG_MM_REGIONS=2
CONFIG_GRAN=y

#
# Audio Support
#

#
# Binary Formats
#
CONFIG_BUILTIN=y

#
# Library Routines
#

#
# Standard C Library Options
#
CONFIG_STDIO_BUFFER_SIZE=32
CONFIG_STDIO_LINEBUFFER=y
CONFIG_NUNGET_CHARS=2
CONFIG_LIB_HOMEDIR="/"
CONFIG_LIBC_FLOATINGPOINT=y
CONFIG_LIB_RAND_ORDER=1
CONFIG_EOL_IS_EITHER_CRLF=y
CONFIG_POSIX_SPAWN_PROXY_STACKSIZE=1024
CONFIG_TASK_SPAWN_DEFAULT_STACKSIZE=2048
CONFIG_LIBC_STRERROR=y
CONFIG_ARCH_LOWPUTC=y
CONFIG_LIB_SENDFILE_BUFSIZE=512
CONFIG_ARCH_OPTIMIZED_FUNCTIONS=y
CONFIG_ARCH_MEMCPY=y

#
# Non-standard Library Support
#
CONFIG_SCHED_WORKQUEUE=y
CONFIG_SCHED_HPWORK=y
CONFIG_SCHED_WORKPRIORITY=192
CONFIG_SCHED_WORKPERIOD=5000
CONFIG_SCHED_WORKSTACKSIZE=1600
CONFIG_SCHED_LPWORK=y
CONFIG_SCHED_LPWORKPRIORITY=50
CONFIG_SCHED_LPWORKPERIOD=50000
CONFIG_SCHED_LPWORKSTACKSIZE=1600

#
# Basic CXX Support
#
CONFIG_C99_BOOL8=y
CONFIG_HAVE_CXX=y
CONFIG_HAVE_CXXINITIALIZE=y

#
# uClibc++ Standard C++ Library
#

#
# Application Configuration
#

#
# Built-In Applications
#
CONFIG_BUILTIN_PROXY_STACKSIZE=1024

#
# Examples
#
CONFIG_SYSTEM_CDCACM=y
CONFIG_SYSTEM_MOUNT=y
CONFIG_SYSTEM_NSH=y

#
# Graphics Support
#

#
# Interpreters
#

#
# Network Utilities
#

#
# Networking Utilities
#

#
# FreeModBus
#

#
# NSH Library
#
CONFIG_NSH_LIBRARY=y
CONFIG_NSH_BUILTIN_APPS=y

#
# Disable Individual commands
#

#
# Configure Command Options
#
CONFIG_NSH_CODECS_BUFSIZE=128
CONFIG_NSH_FILEIOSIZE=512
CONFIG_NSH_STRERROR=y
CONFIG_NSH_LINELEN=128
CONFIG_NSH_MAXARGUMENTS=12
CONFIG_NSH_NESTDEPTH=8
CONFIG_NSH_ROMFSETC=y
CONFIG_NSH_ROMFSMOUNTPT="/etc"
CONFIG_NSH_INITSCRIPT="init.d/rcS"
CONFIG_NSH_ROMFSDEVNO=0
CONFIG_NSH_ROMFSSECTSIZE=128
CONFIG_NSH_ARCHROMFS=y
CONFIG_NSH_FATDEVNO=1
CONFIG_NSH_FATSECTSIZE=512
CONFIG_NSH_FATNSECTORS=1024
CONFIG_NSH_FATMOUNTPT="/tmp"
CONFIG_NSH_CONSOLE=y

#
# USB Trace Support
#
CONFIG_NSH_ARCHINIT=y

#
# NxWidgets/NxWM
#

#
# System NSH Add-Ons
#

#
# Custom Free Memory Command
#

#
# I2C tool
#

#
# FLASH Program Installation
#

#
# FLASH Erase-all Command
#

#
# readline()
#
CONFIG_SYSTEM_READLINE=y
CONFIG_READLINE_ECHO=y

#
# Power Off
#

#
# RAMTRON
#

#
# SD Card
#

#
# Sysinfo
#
CONFIG_SYSTEM_SYSINFO=y

#
# USB Monitor
#

CONFIG_NSOCKET_DESCRIPTORS=0

#
# setup for 2MByte flash part
#
CONFIG_STM32_FLASH_CONFIG_I=y

CONFIG_DEBUG_HARDFAULT_INFO=y
CONFIG_DEBUG_INFO=y
CONFIG_DEBUG_HARDFAULT_ALERT=y
```
